/dts-v1/;
/plugin/;

/ {
    compatible = "allwinner,sun8i-h2-plus";
    fragment@0 {
        target = <&uart1>;
        __overlay__ {
            pinctrl-names = "default";
            pinctrl-0 = <&uart1_pins>;
            status = "okay";
            compatible = "pivccu,dw_apb";
            pivccu,gpio_pin = <7>;
        };
    };
};

