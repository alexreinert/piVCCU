/dts-v1/;
/plugin/;

/ {
    compatible = "allwinner,sun8i-h3";
    fragment@0 {
        target = <&uart3>;
        __overlay__ {
            pinctrl-names = "default";
            pinctrl-0 = <&uart3_pins>;
            status = "okay";
            compatible = "pivccu,dw_apb";
            pivccu,gpio_pin = <110>;
        };
    };
};

