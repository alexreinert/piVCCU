/dts-v1/;
/plugin/;

/ {
  compatible = "allwinner,sun50i-h5";
  fragment@0 {
    target = <&uart1>;
    __overlay__ {
      pinctrl-names = "default";
      pinctrl-0 = <&uart1_pins>;
      status = "okay";
      compatible = "pivccu,dw_apb";
      pivccu,reset_pin = <&pio 0 7 0>;
    };
  };
};

